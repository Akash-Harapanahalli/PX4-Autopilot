## src/modules/mc_pgf_control/Kconfig
```kconfig
menuconfig MODULES_MC_PGF_CONTROL
	bool "mc_pgf_control"
	default n
	---help---
		Enable support for mc_pgf_control

menuconfig USER_MC_PGF_CONTROL
	bool "mc_pgf_control running as userspace module"
	default y
	depends on BOARD_PROTECTED && MODULES_MC_PGF_CONTROL
	---help---
		Put mc_pgf_control in userspace memory
```

## src/modules/simulation/pgf_sim_bridge/Kconfig
```kconfig
menuconfig MODULES_SIMULATION_PGF_SIM_BRIDGE
	bool "pgf_sim_bridge"
	default n
	---help---
		Simulation-only UDP stand-in for the PGF companion computer
```
